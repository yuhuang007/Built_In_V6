## Built_In_V6/firmware/p4_camera_probe/sdkconfig.defaults
```kconfig
CONFIG_IDF_EXPERIMENTAL_FEATURES=y
CONFIG_ESPTOOLPY_FLASHSIZE_16MB=y
CONFIG_SPIRAM=y
CONFIG_SPIRAM_MODE_HEX=y
CONFIG_SPIRAM_SPEED_200M=y
CONFIG_SPIRAM_USE_MALLOC=y
CONFIG_SPIRAM_MEMTEST=y
CONFIG_CAMERA_SC2336=y
CONFIG_CAMERA_SC2336_AUTO_DETECT_MIPI_INTERFACE_SENSOR=y
CONFIG_CAMERA_SC2336_MIPI_RAW8_1920X1080_30FPS=y
# CONFIG_CAMERA_SC2336_MIPI_RAW8_1280X720_30FPS is not set
CONFIG_CAMERA_SC2336_MIPI_DEFAULT_FMT_RAW8_1920X1080_30FPS=y
CONFIG_BSP_LCD_DPI_BUFFER_NUMS=2
CONFIG_BSP_LCD_COLOR_FORMAT_RGB565=y
CONFIG_BSP_LCD_USE_DMA2D=y
CONFIG_BSP_LCD_TYPE_1024_600=y
CONFIG_FREERTOS_ISR_STACKSIZE=4096
CONFIG_ESP_MAIN_TASK_STACK_SIZE=16384
CONFIG_ESP_SYSTEM_HW_STACK_GUARD=y
```

## Built_In_V6/firmware/p4_main/main/Kconfig.projbuild
```kconfig
menu "Built_In_V6 cloud voice configuration"

config VOLC_RTC_MODE
    bool "Enable Volcano Engine high-quality RTC transport"
    default y
    help
        Build the P4-specific VolcEngine RTC client contained in the locally
        downloaded ConversationalAI Embedded Kit. Credentials are intentionally
        not Kconfig values; they are read only from the Git-ignored secrets
        header.

endmenu

config P4_SIGN_LANGUAGE_MODE
    bool "Enable demand-driven sign-language camera preview"
    default n
    help
        Adds a camera entry to the voice home screen. Only the separate sign
        build profile enables this; the stable display profile stays voice-only.

config P4_ASR_MODE
    bool "Enable standalone push-to-talk Doubao ASR"
    default n
    help
        Separate 16 kHz transcription, with no LLM/TTS. Credentials live only
        in the Git-ignored secrets/doubao_asr.h, not in Kconfig or logs.
```
